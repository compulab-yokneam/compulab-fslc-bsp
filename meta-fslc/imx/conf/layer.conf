## meta-fslc/imx/conf/layer.conf
```bitbake
# We have a conf and classes directory, append to BBPATH
BBPATH .= ":${LAYERDIR}"

# We have a recipes directory containing .bb and .bbappend files, add to BBFILES
BBFILES += "${LAYERDIR}/recipes*/*/*.bb \
            ${LAYERDIR}/recipes*/*/*.bbappend"

# The layer contains no recipes, so these lines commented out
# BBFILE_COLLECTIONS += "meta-fslc-som-common"
# BBFILE_PATTERN_meta-fslc-som-common := "^${LAYERDIR}/"
# BBFILE_PRIORITY_meta-fslc-som-common = "9"

LAYERSERIES_COMPAT_meta-fslc-som-common = "dunfell gatesgarth hardknott kirkstone"

BBMASK += " compulab-ucm-imx8m-mini.bb "
BBMASK += " compulab-qt5-build-env.bb "
BBMASK += " u-boot-imx-fw-utils_2019.04.bbappend "
BBMASK += " u-boot-fw-utils_%.bbappend "
BBMASK += " nxp-demo-experience_%.bbappend "

# Each machin has its own provider in its conf file
# PREFERRED_RROVIDER_u-boot-fw-utils = "u-boot-compulab-fw-utils"

PREFERRED_PROVIDER_virtual/kernel:mcm-imx8m-mini = "linux-compulab"
PREFERRED_PROVIDER_virtual/kernel:ucm-imx8m-mini = "linux-compulab"
PREFERRED_PROVIDER_virtual/kernel:iot-gate-imx8  = "linux-compulab"
PREFERRED_PROVIDER_virtual/kernel:ucm-imx8m-plus = "linux-compulab"
PREFERRED_PROVIDER_virtual/kernel:som-imx8m-plus = "linux-compulab"

PREFERRED_PROVIDER_virtual/bootloader:mcm-imx8m-mini = "u-boot-compulab"
PREFERRED_PROVIDER_virtual/bootloader:ucm-imx8m-mini = "u-boot-compulab"
PREFERRED_PROVIDER_virtual/bootloader:iot-gate-imx8  = "u-boot-compulab"
PREFERRED_PROVIDER_virtual/bootloader:ucm-imx8m-plus = "u-boot-compulab"
PREFERRED_PROVIDER_virtual/bootloader:som-imx8m-mini = "u-boot-compulab"
#
# Use systemd as default init manager
DISTRO_FEATURES:append = " systemd"
VIRTUAL-RUNTIME_init_manager = "systemd"
PREFERRED_PROVIDER_udev = "systemd"
PREFERRED_PROVIDER_udev-utils = "systemd"
VIRTUAL-RUNTIME_initscripts = ""
POKY_DEFAULT_DISTRO_FEATURES:append = " systemd"
IMX_DEFAULT_DISTRO_FEATURES:append = " systemd"
#
SOC_DEFAULT_WKS_FILE = "imx-imx-boot-bootpart.wks.in"
```

## meta-fslc/imx8mm/conf/layer.conf
```bitbake
# We have a conf and classes directory, append to BBPATH
BBPATH .= ":${LAYERDIR}"

# We have a recipes directory containing .bb and .bbappend files, add to BBFILES
BBFILES += "${LAYERDIR}/recipes*/*/*.bb \
            ${LAYERDIR}/recipes*/*/*.bbappend"

BBFILE_COLLECTIONS += "meta-fslc-som"
BBFILE_PATTERN_meta-fslc-som := "^${LAYERDIR}/"
BBFILE_PRIORITY_meta-fslc-som = "9"

LAYERSERIES_COMPAT_meta-fslc-som = "dunfell gatesgarth hardknott kirkstone"

PLATFORM_FLAVOR:ucm-imx8m-mini = "mx8mmevk"
PLATFORM_FLAVOR:mcm-imx8m-mini = "mx8mmevk"
PLATFORM_FLAVOR:iot-gate-imx8  = "mx8mmevk"
PLATFORM = "imx8mm"
ATF_MACHINE_NAME = "bl31-imx8mm.bin"
SOC_TARGET = "iMX8MM"

SOC_DEFAULT_WKS_FILE = "imx-imx-boot-bootpart.wks.in"

PREFERRED_PROVIDER_virtual/kernel = "linux-compulab"
PREFERRED_PROVIDER_virtual/bootloader = "u-boot-compulab"

CORE_IMAGE_EXTRA_INSTALL:remove = "firmware-imx-sdma"
CORE_IMAGE_EXTRA_INSTALL:append = "linux-firmware-imx-sdma-imx6q linux-firmware-imx-sdma-imx7d"
```

## meta-fslc/imx8mp/conf/layer.conf
```bitbake
# We have a conf and classes directory, append to BBPATH
BBPATH .= ":${LAYERDIR}"

# We have a recipes directory containing .bb and .bbappend files, add to BBFILES
BBFILES += "${LAYERDIR}/recipes*/*/*.bb \
            ${LAYERDIR}/recipes*/*/*.bbappend"

BBFILE_COLLECTIONS += "meta-fslc-som"
BBFILE_PATTERN_meta-fslc-som := "^${LAYERDIR}/"
BBFILE_PRIORITY_meta-fslc-som = "9"

LAYERSERIES_COMPAT_meta-fslc-som = "dunfell gatesgarth hardknott kirkstone"

PLATFORM_FLAVOR:ucm-imx8m-plus = "mx8mpevk"
PLATFORM_FLAVOR:som-imx8m-plus = "mx8mpevk"
PLATFORM = "imx8mp"
ATF_MACHINE_NAME = "bl31-imx8mp.bin"
SOC_TARGET = "iMX8MP"

SOC_DEFAULT_WKS_FILE = "imx-imx-boot-bootpart.wks.in"

PREFERRED_PROVIDER_virtual/kernel = "linux-compulab"
PREFERRED_PROVIDER_virtual/bootloader = "u-boot-compulab"

CORE_IMAGE_EXTRA_INSTALL:remove = "firmware-imx-sdma"
CORE_IMAGE_EXTRA_INSTALL:append = "linux-firmware-imx-sdma-imx6q linux-firmware-imx-sdma-imx7d"

FW_VER = "202006"

BBMASK += " imx-m7-demos_%.bbappend nnshark_%.bbappend "
```
